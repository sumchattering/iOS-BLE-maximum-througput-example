## CMakeLists.txt
```
cmake_minimum_required(VERSION 3.13.1)

set(BOARD nrf52833dk_nrf52833)
find_package(Zephyr REQUIRED HINTS $ENV{ZEPHYR_BASE})
project(maximum-throughput-example)

target_include_directories(app
    PRIVATE
        include
)

target_sources(app
    PRIVATE
        src/main.c
        src/ble.c
        src/test_service.c
)
```

## prj.conf
```kconfig
CONFIG_LOG=y

CONFIG_CONSOLE=y
CONFIG_USE_SEGGER_RTT=y
CONFIG_RTT_CONSOLE=y

CONFIG_BT=y
CONFIG_BT_DEBUG_LOG=y
CONFIG_BT_PERIPHERAL=y
CONFIG_BT_DEVICE_NAME="Maximum Throughput Example"

CONFIG_MINIMAL_LIBC_MALLOC_ARENA_SIZE=1000
```

## src/main.c
```c
/* main.c - Application main entry point */

/*
 * Copyright (c) 2015-2016 Intel Corporation
 *
 * SPDX-License-Identifier: Apache-2.0
 */

#include <logging/log.h>
LOG_MODULE_REGISTER(testservice, LOG_LEVEL_DBG);

void main(void)
{
	LOG_INF("boot: Maximum throughput example");

	ble__enable();

	while (1) {
		k_sleep(K_SECONDS(1));
	}
}
```

## include/ble.h
```c
#ifndef BLE_H_
#define BLE_H_

void ble__enable(void);

#endif  // BLE_H_
```

## include/test_service.h
```c
#ifndef TEST_SERVICE_H_
#define TEST_SERVICE_H_

#include <bluetooth/conn.h>

void test_service__notify_connect(struct bt_conn *conn);
void test_service__notify_disconnect(struct bt_conn *conn);

#endif  // BLE_DOWNLOAD_SERVICE_H_
```

## src/ble.c
```c
#include "ble.h"

#include <bluetooth/bluetooth.h>
#include <bluetooth/conn.h>
#include <logging/log.h>

#include "test_service.h"

LOG_MODULE_REGISTER(ble, LOG_LEVEL_DBG);

// Advertising Data

#define ADV_PARAMS BT_LE_ADV_PARAM(BT_LE_ADV_OPT_USE_NAME | BT_LE_ADV_OPT_CONNECTABLE, BT_GAP_ADV_FAST_INT_MIN_1, BT_GAP_ADV_FAST_INT_MAX_1, NULL)

static const struct bt_data advertising_data[] = {
    BT_DATA_BYTES(BT_DATA_FLAGS, (BT_LE_AD_GENERAL | BT_LE_AD_NO_BREDR)),
    BT_DATA_BYTES(BT_DATA_UUID128_ALL,
		      0xf0, 0xde, 0xbc, 0x9a, 0x78, 0x56, 0x34, 0x12,
		      0x78, 0x56, 0x34, 0x12, 0x78, 0x56, 0x34, 0x12),
};

// Connection Callbacks

static void connected_cb(struct bt_conn *conn, uint8_t conn_err)
{
    if (conn_err) {
        LOG_ERR("connection failed: 0x%02x", conn_err);
        return;
    }

    LOG_INF("connected");
    test_service__notify_connect(conn);
}

static void disconnected_cb(struct bt_conn *conn, uint8_t reason)
{
    LOG_INF("disconnected: 0x%02x", reason);
    test_service__notify_disconnect(conn);
}

static struct bt_conn_cb conn_callbacks = {
    .connected    = connected_cb,
    .disconnected = disconnected_cb,
};

// Ready Callback

static void ready_cb(int err)
{
    if (err) {
		LOG_ERR("Bluetooth init failed (err %d)\n", err);
        return;
    }

    bt_conn_cb_register(&conn_callbacks);

    int rc = bt_le_adv_start(ADV_PARAMS, advertising_data, ARRAY_SIZE(advertising_data), NULL, 0);
    if (rc) {
    	LOG_ERR("Bluetooth advertising failed [%d]", rc);
    } else {
    	LOG_INF("Bluetooth is ready and started Advertising");
    }
}

void ble__enable(void)
{
    int err = bt_enable(ready_cb);
	if (err) {
		LOG_ERR("Bluetooth enable failed (err %d)\n", err);
		return;
	}
}
```

## src/test_service.c
```c
#include <logging/log.h>
LOG_MODULE_REGISTER(test_service, LOG_LEVEL_DBG);

#include <bluetooth/bluetooth.h>
#include <bluetooth/conn.h>
#include <bluetooth/gatt.h>
#include <logging/log.h>
#include <stdint.h>
#include <stdlib.h>

K_SEM_DEFINE(test_frag__sem, 0, 1);
static struct bt_conn *current_conn = NULL;

#define UUID_BASE_W32            0xa3dc0000
#define UUID_BASE_W1             0x78f8
#define UUID_BASE_W2             0x44de
#define UUID_BASE_W3             0xbc0f
#define UUID_BASE_W48            0x05291d85f5aa
#define UUID_128_ENCODE(uuid_16) BT_UUID_128_ENCODE(UUID_BASE_W32 | (uuid_16), UUID_BASE_W1, UUID_BASE_W2, UUID_BASE_W3, UUID_BASE_W48)

#define TEST_SERVICE_UUID BT_UUID_DECLARE_128(UUID_128_ENCODE(0x0001))
#define TEST_CHARACTERISTIC_UUID  BT_UUID_DECLARE_128(UUID_128_ENCODE(0x0002))
#define TEST_CHARACTERISTIC_PROPS (BT_GATT_CHRC_NOTIFY)
#define TEST_CHARACTERISTIC_PERM  (BT_GATT_PERM_NONE)

static void test__ccc_cb(const struct bt_gatt_attr *attr, uint16_t value);
static void send_zeroes();
#define CCC_PERM (BT_GATT_PERM_READ | BT_GATT_PERM_WRITE)

BT_GATT_SERVICE_DEFINE(
    test_service,
    BT_GATT_PRIMARY_SERVICE(TEST_SERVICE_UUID),
    BT_GATT_CHARACTERISTIC(TEST_CHARACTERISTIC_UUID, TEST_CHARACTERISTIC_PROPS, TEST_CHARACTERISTIC_PERM, NULL, NULL, NULL),
    BT_GATT_CCC(test__ccc_cb, CCC_PERM), );

static void test__ccc_cb(const struct bt_gatt_attr *attr, uint16_t value)
{
    if (value & BT_GATT_CCC_NOTIFY) {
        LOG_INF("Subscribed to sending data");
        send_zeroes();
    } else {
        LOG_INF("unsubscribed to sending data");
    }
}

static void test__frag_notif_complete_cb(struct bt_conn *conn, void *user_data)
{
    k_sem_give(&test_frag__sem);
    LOG_INF("Data Sent %d");
}

// data_upload callbacks ///////////////////////////////////////////////////////
static void send_zeroes()
{
    int rc;

    if (current_conn == NULL) {
        LOG_WRN("connection dropped");
    }

    size_t max_fragment_len = bt_gatt_get_mtu(current_conn) - 3;
    uint8_t *fragment = malloc(sizeof(uint8_t) * max_fragment_len);
    memset(fragment, 0, sizeof fragment);

    int count = 0;
    while (count < 10) {
        LOG_INF("Sending data %d", max_fragment_len);

        struct bt_gatt_notify_params params = {
            .uuid = NULL,
            .attr = &test_service.attrs[2],
            .data = fragment,
            .len  = max_fragment_len,
            .func = test__frag_notif_complete_cb,
        };

        rc = bt_gatt_notify_cb(current_conn, &params);

        switch (rc) {
            case 0:
            	count = count + 1; 
                break;

            case -ENOMEM:
                LOG_INF("bufs full");
                rc = k_sem_take(&test_frag__sem, K_MSEC(100));
                if (rc) {
                    LOG_ERR("fragment send timeout (%d)", rc);
                    return;
                }
                break;

            default:
                LOG_ERR("failed sending notification (%d)", rc);
                return;
        }
    }
}


// App API calls ///////////////////////////////////////////////////////////////
void test_service__notify_connect(struct bt_conn *conn)
{
    if (current_conn != NULL) {
        LOG_ERR("unexpected connection: %p, %p", conn, current_conn);
        return;
    }

    current_conn = bt_conn_ref(conn);
    LOG_INF("MTU Size %d", bt_gatt_get_mtu(current_conn));
}

void test_service__notify_disconnect(struct bt_conn *conn)
{
    if (conn != current_conn) {
        LOG_ERR("incorrect connection: %p, %p", conn, current_conn);
        return;
    }

    bt_conn_unref(conn);
    current_conn = NULL;
}
```
